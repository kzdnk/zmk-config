## boards/shields/ec_s2_wireless/Kconfig.defconfig
```kconfig
if SHIELD_EC_S2_WIRELESS_RIGHT

config ZMK_KEYBOARD_NAME
    default "ec_s2_wireless"

config ZMK_SPLIT_ROLE_CENTRAL
    default y

config ZMK_STUDIO
    default y

endif

if SHIELD_EC_S2_WIRELESS_LEFT || SHIELD_EC_S2_WIRELESS_RIGHT

config ZMK_SPLIT
    default y

endif
```

## boards/shields/ec_s2_wireless/Kconfig.shield
```kconfig
config SHIELD_EC_S2_WIRELESS_LEFT
    def_bool $(shields_list_contains,ec_s2_wireless_left)

config SHIELD_EC_S2_WIRELESS_RIGHT
    def_bool $(shields_list_contains,ec_s2_wireless_right)
```
