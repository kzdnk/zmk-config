// This file was generated from a template. Edit it to match your keyboard.
// See https://zmk.dev/docs/development/hardware-integration/new-shield for more
// instructions.

#include "ec_s2_wireless.dtsi"
#include <physical_layouts.dtsi>

&default_transform {
    col-offset = <5>;
};
